 /*
  * Overlay aimed to add an ATTINY2313A microcontroller on I2C_A0, address 0x8.
  */

/dts-v1/;
/plugin/;

/ {
	compatible = "libretech,cc", "amlogic,s905x", "amlogic,meson-gxl";

	fragment@1 {
		target = <&i2c_AO>;
		
		__overlay__ {
			micro@8 {
				compatible = "atmel,attiny2313a";
				reg = <0x8>;
			};
		};
	};
};
